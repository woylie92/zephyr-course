/ {
    aliases{
        // from nucleo_f446re.dts:
        // led0 = &green_led_2;
        app-led = &green_led_2;  
    };
};

/ {
	our_led_sensor0: our_led_sensor0 {
		compatible = "our,led-sensor";
		led-gpios = <&gpioa 5 GPIO_ACTIVE_HIGH>;
		status = "okay";
	};
};