## app/Kconfig
```kconfig
menuconfig LED_SUBSYSTEM
    bool "LED Subsystem"
    default y

if LED_SUBSYSTEM

choice
    prompt "LED blink sleep time"
    default BLINK_SPEED_1000MS
config BLINK_SPEED_250MS
    bool "0.25s (fast)"
config BLINK_SPEED_500MS
    bool "0.5s (medium fast)"
config BLINK_SPEED_1000MS
    bool "1s (medium)"
config BLINK_SPEED_2000MS
    bool "2s (slow)"
endchoice

config BLINK_SLEEP_TIME_MS
    int 
    default 250 if BLINK_SPEED_250MS
    default 500 if BLINK_SPEED_500MS
    default 1000 if BLINK_SPEED_1000MS
    default 2000 if BLINK_SPEED_2000MS
    default 0

    help
        Time between LED toggles in milliseconds.

menuconfig ADVANCED_LED_SETTINGS
    bool "Advanced LED Settings"
    default n

if ADVANCED_LED_SETTINGS

config LED_BRIGHTNESS
    int "LED brightness (0-100)"
    default 100
    range 0 100

config LED_FADE_DURATION
    int "LED fade duration (ms)"
    default 500
    range 0 5000

menu "Expert Settings"
    visible if ADVANCED_LED_SETTINGS

config LED_DEBUGGING
    bool "Enable LED debugging"
    default n

config CUSTOM_BLINK_PATTERN
    bool "Custom blink pattern"
    default n

endmenu

endif # ADVANCED_LED_SETTINGS

endif # LED_SUBSYSTEM

menu "Heartbeat LED Configuration"

config APP_HEARTBEAT_PERIOD_MS
	int "Heartbeat LED blink period (ms)"
	default 500
	range 100 2000
	help
	  Period, in milliseconds, of the heartbeat LED on/off cycle.

endmenu

source "Kconfig.zephyr"
```

## app/drivers/our_driver/Kconfig
```kconfig
menuconfig OUR_LED_SENSOR
	bool "Our custom LED sensor driver"
	default y
	depends on DT_HAS_OUR_LED_SENSOR_ENABLED
	select GPIO
	select SENSOR
	help
	  Enable the custom driver that exposes an on-board LED through
	  the standard Zephyr Sensor API.

if OUR_LED_SENSOR

module = OUR_LED_SENSOR
module-str = our LED sensor driver
source "subsys/logging/Kconfig.template.log_config"

endif # OUR_LED_SENSOR
```

## app/dts/bindings/driver/our,led-sensor.yaml
```yaml
description: |
  On-board LED exposed through Zephyr's Sensor API...

compatible: "our,led-sensor"

include: base.yaml

properties:
  led-gpios:
    type: phandle-array
    required: true
    description: GPIO connected to the on-board LED
```

## boards/copy_board/board.yml
```yaml
board:
  name: copy_board
  full_name: Copy Board Assignment
  vendor: st
  socs:
    - name: stm32f446xx
```
